## conf/layer.conf
```bitbake
# We have a conf and classes directory, add to BBPATH
BBPATH .= ":${LAYERDIR}"

# We have recipes-* directories, add to BBFILES
BBFILES += "${LAYERDIR}/recipes-*/*/*.bb \
	${LAYERDIR}/recipes-*/*/*.bbappend"

BBFILE_COLLECTIONS += "meta-arp"
BBFILE_PATTERN_meta-arp = "^${LAYERDIR}/"
BBFILE_PRIORITY_meta-arp = "6"

LAYERSERIES_COMPAT_arp-layer = "sumo thud"

# Let us add layer-specific bbappends which are only applied when that
# layer is included in our configuration
BBFILES += "${@' '.join('${LAYERDIR}/layers/%s/recipes*/*/*.bbappend' % layer \
               for layer in BBFILE_COLLECTIONS.split())}"
# Do the same for recipes
BBFILES += "${@' '.join('${LAYERDIR}/layers/%s/recipes*/*/*.bb' % layer \
               for layer in BBFILE_COLLECTIONS.split())}"
```

## conf/machine/arp.conf
```bitbake
#@TYPE: Machine
#@NAME: arp

#@DESCRIPTION: Machine configuration for Automotive Reference Platform

require conf/machine/intel-corei7-64.conf
```
